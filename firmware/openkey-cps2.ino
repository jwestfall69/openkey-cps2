#include <avr/sleep.h>

// PIN 9 (PIN_B1) <=> CN9 PIN 2
#define SET_DATA      PORTB.OUTSET = PIN0_bm
#define CLR_DATA      PORTB.OUTCLR = PIN0_bm

// PIN 8 (PIN_B0) <=> CN9 PIN 3
#define SET_SETUP    PORTB.OUTSET = PIN1_bm
#define CLR_SETUP    PORTB.OUTCLR = PIN1_bm

// PIN 6 (PIN_B3) <=> CN9 PIN 4
#define SET_RESET     PORTB.OUTSET = PIN3_bm
#define CLR_RESET     PORTB.OUTCLR = PIN3_bm

// PIN 7 (PIN_B2) <=> CN9 PIN 5
#define SET_CLOCK     PORTB.OUTSET = PIN2_bm
#define CLR_CLOCK     PORTB.OUTCLR = PIN2_bm

// doing bit shifting takes a variable amount
// of time depending on the how far the shift
// is.  Using the below lookup table to try
// and keep a consistent clock period when
// sending data.
uint8_t masks[8] = {
  0x01, 0x02, 0x04, 0x08,
  0x10, 0x20, 0x40, 0x80,
};

// The key data below comes from mame.  Each game has a .key file, which contains the 20 bytes.
// ie: https://github.com/mamedev/mame/blob/master/src/mame/capcom/cps2.cpp#L1900
#define CONFIG_SIZE   6
#define WATCHDOG_SIZE 6
#define KEY_SIZE      4

// There are only 10 unique combinations of the first 6 bytes
// of all key data.  In order to save about 800 bytes of flash
// we are using the below lookup table for these 6 bytes. 
// Without the lookup table the code compiles very near to 4k,
// which would put it at risk of not being viable on attiny4x4s
uint8_t config_table[][CONFIG_SIZE] = {
 { 0x01, 0x00, 0x02, 0x40, 0x00, 0x08 },  // 0x00
 { 0x01, 0x00, 0x02, 0x40, 0x00, 0x09 },  // 0x01
 { 0x01, 0x00, 0x02, 0x40, 0x00, 0x0a },  // 0x02
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 { 0xff, 0xff, 0xff, 0xff, 0xff, 0xff },  // 0x09
};

struct game_data_t {
  uint8_t config_table_index;
  uint8_t watchdog[WATCHDOG_SIZE];
  uint8_t key2[KEY_SIZE];
  uint8_t key1[KEY_SIZE];
};

#define MAX_GAME_NUM 174
struct game_data_t game_data[MAX_GAME_NUM + 1] = {
  // config table                                                                                                          jumpers
  //    index                  watchdog config                         key#2                        key#1                  12345678 raw key filename
  {     0x06,       { 0x84, 0xc2, 0xeb, 0x7a, 0x3c, 0xa5 },  { 0xf4, 0x38, 0xeb, 0x65 },  { 0x79, 0x9c, 0xbf, 0x70 } }, // 00000000 1944.key
  {     0x06,       { 0x84, 0xc2, 0xeb, 0x7a, 0x3c, 0xa5 },  { 0x8b, 0x93, 0x46, 0x1d },  { 0x70, 0xe7, 0xaf, 0x10 } }, // 00000001 1944j.key
  {     0x06,       { 0x84, 0xc2, 0xeb, 0x7a, 0x3c, 0xa5 },  { 0x78, 0xfe, 0x6b, 0x44 },  { 0xc9, 0x39, 0xf2, 0xe0 } }, // 00000010 1944u.key
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  {     0x07,       { 0x04, 0xc1, 0x3a, 0x63, 0x93, 0x02 },  { 0x0f, 0x72, 0x98, 0x7d },  { 0x2f, 0x03, 0x4f, 0xc8 } }, // 10101101 xmvsfu.key

  // also used with invalid jumper configs
  {     0x09,       { 0xff, 0xff, 0xff, 0xff, 0xff, 0xff },  { 0xff, 0xff, 0xff, 0xff },  { 0xff, 0xff, 0xff, 0xff } }, // 10101110 phoenix.key
    
};

void setup() { 

  delay(50);
  
  // set the programming pins as outputs
  PORTB.DIR = PIN0_bm | PIN1_bm | PIN2_bm | PIN3_bm;

  // enable pull-ups on jumper pins
  PORTA.PIN0CTRL |= PORT_PULLUPEN_bm;
  PORTA.PIN1CTRL |= PORT_PULLUPEN_bm;
  PORTA.PIN2CTRL |= PORT_PULLUPEN_bm;
  PORTA.PIN3CTRL |= PORT_PULLUPEN_bm;
  PORTA.PIN4CTRL |= PORT_PULLUPEN_bm;
  PORTA.PIN5CTRL |= PORT_PULLUPEN_bm;
  PORTA.PIN6CTRL |= PORT_PULLUPEN_bm;
  PORTA.PIN7CTRL |= PORT_PULLUPEN_bm;

  // go into programming mode
  CLR_CLOCK;
  CLR_DATA;
  SET_SETUP;
  CLR_RESET;

  delay(100);

  uint8_t game_num = read_jumpers();
  if(game_num > MAX_GAME_NUM) {
    game_num = MAX_GAME_NUM;
  }

  for(uint8_t i = 0; i < CONFIG_SIZE; i++) {
    send_byte(config_table[game_data[game_num].config_table_index][i]);
  }

  for(uint8_t i = 0; i < WATCHDOG_SIZE; i++) {
    send_byte(game_data[game_num].watchdog[i]);
  }

  for(uint8_t i = 0; i < KEY_SIZE; i++) {
    send_byte(game_data[game_num].key2[i]);
  }

  for(uint8_t i = 0; i < KEY_SIZE; i++) {
    send_byte(game_data[game_num].key1[i]);
  }

  // exit programming mode
  CLR_SETUP;
  SET_RESET;
  CLR_CLOCK;
  CLR_DATA;

  // set all output pins as inputs
  PORTB.DIR = 0;

  // power down
  set_sleep_mode(SLEEP_MODE_PWR_DOWN);
  sleep_enable();
  sleep_cpu();    
}

void loop() {
}

void send_byte(uint8_t data) {
  for(int8_t bit_num = 7; bit_num >= 0;bit_num--) { 
    uint8_t bit = data & masks[bit_num];
    if(bit) {
      SET_DATA;
    } else {
      CLR_DATA;
    }
    
    SET_CLOCK;
    CLR_CLOCK;
  }
}

// JP1 = PA7 = bit7
// JP2 = PA6 = bit6
// JP3 = PA5 = bit5
// JP4 = PA6 = bit4
// JP5 = PA0 = bit3
// JP6 = PA1 = bit2
// JP7 = PA2 = bit1
// JP8 = PA3 = bit0
uint8_t read_jumpers() {
  uint8_t jumpers = 0;
  uint8_t raw;
  uint8_t bit;

  // negate the bits since we are using
  // pull-ups, jumper'd will be low
  raw = PORTA.IN ^ 0xff;

  // upper nible is in the correct order, but lower isnt
  jumpers = raw & 0xf0;

  // reverse the order of the lower nibble
  bit = (raw & 0x1) << 3;
  jumpers = jumpers | bit;

  bit = (raw & 0x2) << 1;
  jumpers = jumpers | bit;

  bit = (raw & 0x4) >> 1;
  jumpers = jumpers | bit;

  bit = (raw & 0x8) >> 3;
  jumpers = jumpers | bit;

  return jumpers;
}
